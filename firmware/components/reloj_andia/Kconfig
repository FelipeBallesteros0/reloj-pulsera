## firmware/components/reloj_andia/Kconfig
```kconfig
menu "Reloj: ANDIA"
    config RELOJ_ANDIA_URL
        string "URL del WebSocket de ANDIA fuera de casa (túnel, wss://)"
        default "wss://andia.example.com/ws"
    config RELOJ_ANDIA_URL_CASA
        string "URL de ANDIA en la LAN de casa (ws://, sin TLS), usada cuando el WiFi es el de RELOJ_WIFI1"
        default "ws://192.168.x.x:8001/ws"
    config RELOJ_ANDIA_TOKEN
        string "Token compartido con el servicio ANDIA"
        default ""
endmenu
```

## firmware/components/reloj_red/Kconfig
```kconfig
menu "Reloj: WiFi"
    config RELOJ_WIFI1_SSID
        string "Red 1 (casa): SSID"
        default ""
    config RELOJ_WIFI1_CLAVE
        string "Red 1 (casa): clave"
        default ""
    config RELOJ_WIFI2_SSID
        string "Red 2 (hotspot): SSID"
        default "Felipe "
        help
            El hotspot del iPhone de Felipe se llama "Felipe " con un espacio al final (se compara byte a byte).
    config RELOJ_WIFI2_CLAVE
        string "Red 2 (hotspot): clave"
        default ""
endmenu
```

## firmware/main/Kconfig.projbuild
```kconfig
menu "Reloj"

    config RELOJ_NOMBRE_BLE
        string "Nombre Bluetooth del reloj"
        default "Reloj"

    config RELOJ_PANTALLA_SEGUNDOS
        int "Segundos sin tocar antes de apagar la pantalla"
        default 20
        range 5 600

    config RELOJ_TACTIL_ESPEJO_Y
        bool "Espejar el eje Y del táctil"
        default n
        help
            Verificado 2026-09-03 con la traza de toques: el FT3168 ya viene alineado con el panel (sin espejo).

    config RELOJ_TACTIL_ESPEJO_X
        bool "Espejar el eje X del táctil"
        default n

    config RELOJ_CONTROL_USB
        bool "Control remoto por el USB (toques y botón simulados, para grabar demos)"
        default n
        help
            Lee órdenes por el USB-Serial/JTAG ("tap x y", "swipe up|down|left|right", "drag x1 y1 x2 y2 ms",
            "pwr", "pwrl", "home") y las ejecuta con un dedo virtual de LVGL. Instala el driver del USB-Serial/JTAG:
            dejarlo desactivado en uso normal.

    config RELOJ_TZ
        string "Zona horaria (formato POSIX TZ)"
        default "<-04>4<-03>,M9.1.6/24,M4.1.6/24"
        help
            Por defecto Chile continental (UTC-4 con horario de verano UTC-3).

endmenu
```
